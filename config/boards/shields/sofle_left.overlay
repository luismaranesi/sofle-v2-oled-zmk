/* LEFT: central (master) por BLE */
&split {
    compatible = "zmk,split-bluetooth";
    status = "okay";
    role = "central";
};

/* garante que TRRS/serial fique desligado */
&split_serial {
    status = "disabled";
};
