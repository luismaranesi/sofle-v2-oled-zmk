/* RIGHT: peripheral por BLE */
&split {
    compatible = "zmk,split-bluetooth";
    status = "okay";
    role = "peripheral";
};

/* garante que TRRS/serial fique desligado */
&split_serial {
    status = "disabled";
};
